## drivers/pinctrl/sprd/Kconfig
```kconfig
# SPDX-License-Identifier: GPL-2.0-only
#
# Spreadtrum pin control drivers
#

config PINCTRL_SPRD
	tristate
	select PINMUX
	select PINCONF
	select GENERIC_PINCONF
	select GENERIC_PINMUX_FUNCTIONS
	help
	  Say Y here to enable Spreadtrum pinctrl driver

config PINCTRL_SPRD_SC9860
	tristate "Spreadtrum SC9860 pinctrl driver"
	depends on OF
	depends on ARCH_SPRD || COMPILE_TEST
	select PINCTRL_SPRD
	help
	  Say Y here to enable Spreadtrum SC9860 pinctrl driver

config PINCTRL_SPRD_QOGIRN6LITE
	tristate "Unisoc QogirN6Lite pinctrl driver"
	depends on OF
	depends on ARCH_SPRD || COMPILE_TEST
	select PINCTRL_SPRD
	help
	  Enable the UMS9621/QogirN6Lite pad and peripheral matrix controller.
	  This includes the IIS matrix used for Bluetooth SCO audio.
```

## drivers/soc/sprd/domain/Kconfig
```kconfig
# SPDX-License-Identifier: GPL-2.0
config SPRD_DISP_PM_DOMAIN_SHARKL3
	tristate "SPRD Display PM Generic Domain for SharkL3"
	default m
	depends on ARCH_SPRD || COMPILE_TEST
	select PM_GENERIC_DOMAINS if PM
	help
	  When you select this feature, it will enable the pm generic
	  power domain for SharkL3 display module.

config SPRD_VPU_PW_DOMAIN
	tristate "SPRD VPU Power Domain"
	default m
	depends on ARCH_SPRD || COMPILE_TEST
	select PM_GENERIC_DOMAINS if PM
	help
	  Vendor power domain driver for the UMS9621 VPU/DPU/VSP power
	  domains ("sprd,vpu-pd").  The display stack (dpu/dsi/gsp) hangs
	  off <&vpu_pd_top>, so without a registered generic PM domain the
	  genpd core returns -EPROBE_DEFER and no display device ever
	  probes.  Stock ships this as sprd-vpu-pw-domain.ko in
	  vendor_dlkm; here it is built in-tree from the vendor source.
```

## drivers/unisoc_platform/sprd_bt/Kconfig
```kconfig
#
# Unisoc Bluetooth device configuration
#
menu "Unisoc Bluetooth Device Drivers"

config UNISOC_WCN_BT
	tristate "SPRDBT_TTY"
	depends on UNISOC_WCN_BSP
	help
	  Bluetooth TTY driver for the Unisoc WCN combo chip (marlin3 and
	  later), talking to the WCN core over the sprdwcn bus. Builds
	  sprdbt_tty.ko.

	  If you want to use Bluetooth on a 23xx-series Unisoc WCN chip,
	  say Y or M here.

endmenu
```

## drivers/unisoc_platform/sprd_wlan_combo/Kconfig
```kconfig
#
# Unisoc Wlan Combo configuration
#
menu "Unisoc Wlan Device Drivers"

config UNISOC_WLAN_COMBO
	tristate "UNISOC_WLAN_COMBO"
	depends on CFG80211
	depends on UNISOC_WCN_BSP
	help
	  Fullmac cfg80211 WLAN driver for the Unisoc WCN combo chip
	  (sc2332/sc2355 and the marlin3/marlin3lite chips built on them),
	  talking to the WCN core over the sprdwcn bus. Builds
	  sprd_wlan_combo.ko.

	  If you want to use WiFi on a 23xx-series Unisoc WCN chip, say Y
	  or M here.

endmenu
```

## drivers/unisoc_platform/sprdwcn/Kconfig
```kconfig
#
# Unisoc WCN device (NEW )configuration
#
menu "Unisoc WCN Device Drivers"
config UNISOC_WCN_BSP
	tristate "UNISOC_WCN_BSP"
	help
	  This is support wcn chip for Unisoc.
	  if you want to use 23xx series wcn chip of Unisoc.
	  please say "y".

config UNISOC_WCN_BSP_USER_VARIANT
	bool "Build the WCN drivers as the production (user) variant"
	depends on UNISOC_WCN_BSP
	help
	  The vendor's Kbuild takes parts of this driver's behaviour from
	  Android's build variant:

	    drivers/unisoc_platform/sprdwcn/Makefile and platform/Makefile
	      ifeq ($(TARGET_BUILD_VARIANT),user)
	      ccflags-y += -DFLAG_WCN_USER

	  and Android's lunch target sets TARGET_BUILD_VARIANT, so a kernel
	  built by hand silently gets the "userdebug" behaviour.  What that
	  means in practice is the assert policy in platform/sysfs.c: after
	  any WCN asset the userdebug default dumps the chip's memory and
	  marks the SDIO card dead (sprd_gem-style "carddump flag set[1]"),
	  which condemns every later start_marlin() until the next reboot,
	  while the user variant resets the chip and carries on.  The
	  loopcheck ping alone is enough to trigger it: the chip gets 4 s to
	  answer and one missed round is treated as an assert.

	  It also selects the qogirl6 reset-pad priority write in
	  btwf_sys_poweron() (boot/wcn_integrate_boot.c).

	  Say Y on a device that has to keep its radios working.
config SC23XX
	bool "SC23XX chip Support"
	#depends on MMC
	default n
	help
	  This is support wcn chip for Unisoc.
	  if you want to use 23xx series wcn chip of Unisoc.
	  please say "y".

config WCN_INTEG
	bool "WCN Integrated chip Support"
	depends on SC23XX
	default n
	help
	  This is support wcn chip for Unisoc.
	  If you want to use WCN integrated chip of Unisoc.
	  Please say "y".

config SC2355
	bool "SC2355 chip Support"
	depends on SC23XX
	default n
	help
	  This is support wcn chip for Unisoc.
	  If you want to use sc2355 chip of Unisoc.
	  Please say "y".

config UMW2652
	bool "UMW2652 chip Support"
	depends on SC23XX
	default n
	help
	  This is support wcn chip for Unisoc.
	  If you want to use umw2652 chip of Unisoc.
	  Please say "y".

config UMW2653
	bool "UMW2653 chip Support"
	depends on SC23XX
	default n
	help
	  This is support wcn chip for Unisoc.
	  If you want to use umw2653 chip of Unisoc.
	  Please say "y".

config SC2342_I
	bool "SC2342 integrated chip Support"
	depends on WCN_INTEG
	default n
	help
	  This is support wcn sc2342 integrated chip unique config for Unisoc.
	  use it distinguish with other integrated chip.
	  If you want to use sc2342 integrated chip of Unisoc.
	  Please say "y".

config UMW2631_I
	bool "UMW2631 integrated chip Support"
	depends on WCN_INTEG
	default n
	help
	  This is support wcn umw2631 integrated chip unique config for unisoc.
	  If you want to use umw2631 integrated chip of unisoc.
	  Please say "y".


# sprd's SDIO device driver based on SC2355...,etc
source "drivers/unisoc_platform/sprdwcn/sdio/Kconfig"

# sprd's wcn platform driver based on SC2355/SC2342...,etc
source "drivers/unisoc_platform/sprdwcn/platform/Kconfig"

# sprd's sleep device driver based on SC2355...,etc
source "drivers/unisoc_platform/sprdwcn/sleep/Kconfig"

# sprd's SIPC device driver based on WCN_INTEG...,etc
source "drivers/unisoc_platform/sprdwcn/sipc/Kconfig"

endmenu
```

## drivers/unisoc_platform/thermal/Kconfig
```kconfig
# SPDX-License-Identifier: GPL-2.0
config UNISOC_SOC_THERMAL
	tristate "sprd soc thermal"
	depends on ARCH_SPRD || THERMAL_OF
	help
	  Say M here to support virtual thermal for soc chip.
```

## sound/soc/sprd/unisoc/Kconfig
```kconfig
# SPDX-License-Identifier: GPL-2.0
#
# Unisoc vendor ASoC stack, imported from
# android_kernel_modules_and_devicetree_oppo_ums9230
# (bsp/modules/kernel5.15/audio/sprd, plus vender/audio/fsa4480).
#
# This is a different stack from the mainline Spreadtrum ASoC drivers in the
# parent directory (sprd-pcm-dma, sprd-mcdt): it is the one the stock image
# actually ships and binds, and it sits on top of the DSP plumbing in
# drivers/unisoc_platform/sprd_audio/.
#
# Only the modules this board binds are imported.  Left out from upstream:
# the sc2721/sc2730 codecs, i2s/vaudio/sprd_dai DAIs, vbc r1p0v3, the i2s and
# tdm machine drivers, the 2-stage dmaengine platform, and the third-party PA
# codecs ucp1301, tfa98xx, sipa and frsm - none of which match this hardware.
# aw87xxx is imported: that one is on the board.

menuconfig SND_SOC_UNISOC
	tristate "Unisoc vendor ASoC stack"
	depends on SND_SOC && ARCH_SPRD
	default n
	help
	  Vendor ASoC stack for Unisoc SoCs (UMS9621 and friends).  Enable the
	  individual pieces below; they are built as separate modules to match
	  the stock vendor_dlkm module set name for name.

if SND_SOC_UNISOC

config SND_SOC_UNISOC_PCM_ROUTING
	tristate "Unisoc PCM routing (sprd-platform-pcm-routing.ko)"
	help
	  DAPM routing between the front-end DAIs and the back-ends.

config SND_SOC_UNISOC_DMAENGINE_PCM
	tristate "Unisoc dmaengine PCM platform (sprd-dmaengine-pcm.ko)"
	depends on SND_SOC_UNISOC_PCM_ROUTING
	help
	  The normal (non-offload) PCM platform driver.

config SND_SOC_UNISOC_COMPR_2STAGE_DMA
	tristate "Unisoc compressed 2-stage DMA platform (sprd-compr-2stage-dma.ko)"
	depends on UNISOC_AUDIO_MEM && UNISOC_AUDIO_SIPC
	select SND_SOC_COMPRESS
	help
	  Compressed-audio playback path, offloaded to the audio DSP.

config SND_SOC_UNISOC_VBC_V4
	tristate "Unisoc VBC v4 back-end DAI (snd-soc-sprd-vbc-v4.ko)"
	depends on SND_SOC_UNISOC_PCM_ROUTING
	help
	  Voice-band codec interface, v4 generation - the back-end DAIs and
	  their register-level plumbing.

config SND_SOC_UNISOC_VBC_FE
	tristate "Unisoc VBC front-end DAI (snd-soc-sprd-vbc-fe.ko)"
	depends on SND_SOC_UNISOC_VBC_V4
	help
	  The front-end DAIs that userspace opens as PCM devices.

config SND_SOC_UNISOC_TDM
	tristate "Unisoc TDM DAI (snd-soc-sprd-tdm.ko)"
	depends on SND_SOC_UNISOC_DMAENGINE_PCM
	help
	  TDM interface DAI.

config SND_SOC_UNISOC_DUMMY_CODEC
	tristate "Unisoc dummy codec (snd-soc-sprd-dummy-codec.ko)"
	help
	  Placeholder codec for back-ends with nothing attached.

config SND_SOC_UNISOC_HEADSET_FSA4480
	tristate "FSA4480 USB-C audio switch (snd-soc-fsa4480.ko)"
	depends on I2C
	help
	  Analog audio switch used on the USB-C headset path.  The stock
	  ump9620 codec is built against this driver's header, so keep it
	  enabled alongside SND_SOC_UNISOC_CODEC_UMP9620.

config SND_SOC_UNISOC_PA_AW87XXX
	tristate "Awinic AW87xxx speaker PA (snd-soc-sprd-pa-aw87xxx.ko)"
	depends on I2C
	help
	  External speaker amplifier.  Present on this board at i2c-6 0x58
	  (sysfs name "aw87xxx_pa"), and selected by the stock device tree:
	  /sound@0 has sprd,spk-ext-pa-info = <0 1 1 0>, i.e. speaker hook
	  index 1, which SND_SOC_UNISOC_CARD maps to the aw87xxx hook.
	  Keep this enabled whenever SND_SOC_UNISOC_CARD is, or the card's
	  aw87xxx_set_profile() reference goes unresolved.

config SND_SOC_UNISOC_CODEC_UMP9620
	tristate "Unisoc UMP9620 codec (snd-soc-sprd-codec-ump9620.ko)"
	depends on SND_SOC_UNISOC_HEADSET_FSA4480
	help
	  Audio codec inside the UMP9620 PMIC, which is the PMIC on this
	  board.

config SND_SOC_UNISOC_CODEC_UMP9620_POWER
	tristate "Unisoc UMP9620 codec power (snd-soc-sprd-codec-ump9620-power.ko)"
	help
	  Regulators feeding the UMP9620 codec block.

config SND_SOC_UNISOC_CODEC_UMP9620_POWER_DEV
	tristate "Unisoc UMP9620 codec power device (snd-soc-sprd-codec-ump9620-power-dev.ko)"
	depends on SND_SOC_UNISOC_CODEC_UMP9620_POWER
	help
	  Registers the platform device the power driver above binds to.

config SND_SOC_UNISOC_PDM_R2P0
	tristate "Unisoc PDM r2p0 (snd-soc-sprd-pdm-r2p0.ko)"
	help
	  PDM digital microphone interface.  Present in the stock module set
	  but binds nothing on this board.

config SND_SOC_UNISOC_CARD
	tristate "Unisoc machine driver (snd-soc-sprd-card.ko)"
	depends on SND_SOC_UNISOC_VBC_FE && SND_SOC_UNISOC_CODEC_UMP9620
	help
	  The machine driver that ties the DAIs, platform and codec together
	  into the sound card userspace sees.

endif # SND_SOC_UNISOC
```
